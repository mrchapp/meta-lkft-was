## conf/distro/lkft.conf
```bitbake
require conf/distro/include/rpb.inc

DISTRO_NAME = "Linux-Kernel-Functional-Testing"
DISTRO_FEATURES_remove = "wayland"

CMDLINE_remove = "quiet"

GCCVERSION = "7.%"

PREFERRED_PROVIDER_virtual/kernel ?= "linux-generic-mainline"
IMAGE_FSTYPES_remove = "ext4 iso wic wic.gz"
RDEPENDS_packagegroup-rpb_remove = "docker"
```
